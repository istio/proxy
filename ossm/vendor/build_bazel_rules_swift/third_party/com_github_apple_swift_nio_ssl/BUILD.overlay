load(
    "@build_bazel_rules_swift//swift:swift_interop_hint.bzl",
    "swift_interop_hint",
)
load("@build_bazel_rules_swift//swift:swift_library.bzl", "swift_library")

swift_library(
    name = "NIOSSL",
    srcs = glob([
        "Sources/NIOSSL/**/*.swift",
    ]),
    module_name = "NIOSSL",
    visibility = ["//visibility:public"],
    deps = [
        ":CNIOBoringSSL",
        ":CNIOBoringSSLShims",
        "@com_github_apple_swift_nio//:NIO",
        "@com_github_apple_swift_nio//:NIOConcurrencyHelpers",
        "@com_github_apple_swift_nio//:NIOCore",
        "@com_github_apple_swift_nio//:NIOTLS",
    ],
)

cc_library(
    name = "CNIOBoringSSLShims",
    srcs = glob([
        "Sources/CNIOBoringSSLShims/**/*.c",
    ]),
    hdrs = glob([
        "Sources/CNIOBoringSSLShims/include/**/*.h",
    ]),
    aspect_hints = [":CNIOBoringSSLShims_interop"],
    copts = [],
    includes = ["Sources/CNIOBoringSSLShims/include"],
    visibility = ["//visibility:public"],
    deps = [":CNIOBoringSSL"],
)

swift_interop_hint(
    name = "CNIOBoringSSLShims_interop",
    module_name = "CNIOBoringSSLShims",
)

cc_library(
    name = "CNIOBoringSSL",
    srcs = glob([
        "Sources/CNIOBoringSSL/**/*.h",
        "Sources/CNIOBoringSSL/**/*.c",
        "Sources/CNIOBoringSSL/**/*.cc",
        "Sources/CNIOBoringSSL/**/*.S",
    ]),
    hdrs = glob([
        "Sources/CNIOBoringSSL/include/**/*.h",
        "Sources/CNIOBoringSSL/include/**/*.inc",
    ]),
    aspect_hints = [":CNIOBoringSSL_interop"],
    copts = [],
    includes = ["Sources/CNIOBoringSSL/include"],
    visibility = ["//visibility:public"],
    deps = [],
)

swift_interop_hint(
    name = "CNIOBoringSSL_interop",
    module_name = "CNIOBoringSSL",
)
